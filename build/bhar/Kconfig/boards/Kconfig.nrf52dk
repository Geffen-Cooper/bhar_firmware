## build/bhar/Kconfig/boards/Kconfig.nrf52dk
```kconfig
# Load board Kconfig descriptions.
osource "C:/ncs/v3.0.1/zephyr/boards/nordic/nrf52dk/Kconfig.nrf52dk"
```

## build_debug/Kconfig/boards/Kconfig.defconfig
```kconfig
# Load Zephyr board defconfig descriptions.
osource "C:/ncs/v3.0.1/zephyr/boards/nordic/nrf52dk/Kconfig.defconfig"
```
